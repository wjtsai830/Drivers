## FT5X06/Kconfig
```kconfig
#
# FT5X06 TOUCHSCREEN driver 
#
menu "FT5X06 Touchscreen driver"
config TOUCHSCREEN_FT5X06
	tristate "FT5X06 Touchscreen"
	help
	Choose Y here if you have this Touchscreen chip.
endmenu
```

## gt9xx/Kconfig
```kconfig
#
# Touch Panel driver Gt9xx
#
menu "Gt9xx touch driver"
config TOUCHSCREEN_GT9XX
        tristate "Gt9xx touch driver"
        help
        Choose Y here if you have this Gt9xx touch driver.
endmenu
```

## tef6606/Kconfig
```kconfig
#
# TEF6606 FM driver 
#
menu "TEF6606 FM driver"
config RADIO_TEF6606
	tristate "tef6606 FM Radio"
	default y
	help
	Choose Y here if you have this FM radio chip.
endmenu
```
